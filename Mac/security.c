/*****************************************************************
* Copyright (C) 2017 60Plus Technology Co.,Ltd.*
******************************************************************
* security.c
*
* DESCRIPTION:
*     Data safe
* AUTHOR:
*     Ziming
* CREATED DATE:
*     2018/12/27
* REVISION:
*     v0.1
*
* MODIFICATION HISTORY
* --------------------
* $Log:$
*
*****************************************************************/
/*************************************************************************************************************************
 *                                                       INCLUDES                                                        *
 *************************************************************************************************************************/
#include "loraConfig.h"
#include <stdlib.h>
#include "security.h"
/*************************************************************************************************************************
 *                                                        MACROS                                                         *
 *************************************************************************************************************************/

/*************************************************************************************************************************
 *                                                      CONSTANTS                                                        *
 *************************************************************************************************************************/
const uint8_t securityKey[SECURITY_KEY_LEN] = SECRET_KEY;
/*************************************************************************************************************************
 *                                                       TYPEDEFS                                                        *
 *************************************************************************************************************************/
 
/*************************************************************************************************************************
 *                                                   GLOBAL VARIABLES                                                    *
 *************************************************************************************************************************/
 
/*************************************************************************************************************************
 *                                                  EXTERNAL VARIABLES                                                   *
 *************************************************************************************************************************/
 
/*************************************************************************************************************************
 *                                                    LOCAL VARIABLES                                                    *
 *************************************************************************************************************************/
 
/*************************************************************************************************************************
 *                                                 FUNCTION DECLARATIONS                                                 *
 *************************************************************************************************************************/
 
/*************************************************************************************************************************
 *                                                   PUBLIC FUNCTIONS                                                    *
 *************************************************************************************************************************/
 
/*************************************************************************************************************************
 *                                                    LOCAL FUNCTIONS                                                    *
 *************************************************************************************************************************/


/*****************************************************************
* DESCRIPTION: dataEncrypt
*     
* INPUTS:
*     
* OUTPUTS:
*     
* NOTE:
*     null
*****************************************************************/
uint8_t dataEncrypt( uint8_t *a_data, uint8_t a_size )
{
    srand(HAL_GetTick());
    uint8_t keyNum = rand()%SECURITY_KEY_LEN;
    
    for( uint8_t count = 0; count < a_size; count++ )
    {
        if( keyNum >= 10 )
        {
            //a_data[count]  = (a_data[count]/keyNum)*10 + a_data[count]%keyNum;
        }
        a_data[count] ^= securityKey[keyNum];
    }
    return keyNum;
}


/*****************************************************************
* DESCRIPTION: dataDecode
*     
* INPUTS:
*     
* OUTPUTS:
*     
* NOTE:
*     null
*****************************************************************/
E_typeErr dataDecode( uint8_t a_keyNum, uint8_t *a_data, uint8_t a_size )
{
    if( a_keyNum >= SECURITY_KEY_LEN )
    {
        return E_ERR;
    }
    
    for( uint8_t count = 0; count < a_size; count++ )
    {
        a_data[count] ^= securityKey[a_keyNum];
        
        if( a_keyNum < 10)
        {
            continue;
        }
        //a_data[count]  = (a_data[count]/10)*a_keyNum + a_data[count]%10;
    }
    
    return E_SUCCESS;
}
/****************************************************** END OF FILE ******************************************************/
